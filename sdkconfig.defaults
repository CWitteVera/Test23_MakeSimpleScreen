## sdkconfig.defaults
```kconfig
# ESP-IDF Configuration Defaults
# Waveshare ESP32-S3-Touch-LCD-7
# Apply these before running 'idf.py menuconfig'

#
# Target
#
CONFIG_IDF_TARGET="esp32s3"
CONFIG_IDF_TARGET_ESP32S3=y

#
# Flash
#
CONFIG_ESPTOOLPY_FLASHMODE_QIO=y
CONFIG_ESPTOOLPY_FLASHFREQ_80M=y
CONFIG_ESPTOOLPY_FLASHSIZE_16MB=y
CONFIG_PARTITION_TABLE_CUSTOM=y
CONFIG_PARTITION_TABLE_CUSTOM_FILENAME="partitions.csv"

#
# PSRAM (8MB Octal)
#
CONFIG_SPIRAM=y
CONFIG_SPIRAM_MODE_OCT=y
CONFIG_SPIRAM_SPEED_80M=y
CONFIG_SPIRAM_FETCH_INSTRUCTIONS=y
CONFIG_SPIRAM_RODATA=y

#
# CPU Speed
#
CONFIG_ESP_DEFAULT_CPU_FREQ_MHZ_240=y

#
# Data cache line size (required for RGB DMA stability)
#
CONFIG_ESP32S3_DATA_CACHE_LINE_64B=y

#
# LCD / RGB Panel
#
CONFIG_LCD_RGB_RESTART_IN_VSYNC=y

#
# FreeRTOS tick rate (increase for UI responsiveness)
#
CONFIG_FREERTOS_HZ=1000

#
# Log level
#
CONFIG_LOG_DEFAULT_LEVEL_INFO=y

#
# LVGL port configuration (matches 08_lvgl_Porting baseline)
#
CONFIG_EXAMPLE_LVGL_PORT_TASK_CORE=1
CONFIG_EXAMPLE_LVGL_PORT_AVOID_TEAR_ENABLE=y

#
# LVGL library configuration
#
CONFIG_LV_COLOR_SCREEN_TRANSP=y
CONFIG_LV_MEM_CUSTOM=y
CONFIG_LV_MEMCPY_MEMSET_STD=y
CONFIG_LV_USE_LOG=y
CONFIG_LV_LOG_PRINTF=y
CONFIG_LV_USE_PERF_MONITOR=y
CONFIG_LV_ATTRIBUTE_FAST_MEM_USE_IRAM=y
CONFIG_LV_FONT_MONTSERRAT_12=y
CONFIG_LV_FONT_MONTSERRAT_16=y
CONFIG_LV_FONT_MONTSERRAT_20=y
CONFIG_LV_FONT_MONTSERRAT_24=y
CONFIG_LV_USE_FONT_COMPRESSED=y
CONFIG_LV_USE_IMGFONT=y

#
# WiFi / Networking (required for MQTT)
#
CONFIG_ESP_WIFI_ENABLED=y
CONFIG_ESP32_WIFI_ENABLED=y
CONFIG_ESP_WIFI_STATIC_RX_BUFFER_NUM=10
CONFIG_ESP_WIFI_DYNAMIC_RX_BUFFER_NUM=32
CONFIG_ESP_WIFI_TX_BUFFER=DYNAMIC
CONFIG_LWIP_LOCAL_HOSTNAME="esp32s3-display"

#
# MQTT client
#
CONFIG_MQTT_TRANSPORT_TCP=y
```
